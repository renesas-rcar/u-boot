## arch/arm/mach-renesas/Kconfig.64
```kconfig
if RCAR_64

config SYS_MALLOC_F_LEN
	default 0x8000 if RCAR_64

config OF_LIBFDT_OVERLAY
	default y if RCAR_64

config TEXT_BASE
	default 0x50000000 if RCAR_64 && !RCAR_GEN5
	default 0x8E300000 if RCAR_GEN5

source "arch/arm/mach-renesas/Kconfig.rcar3"
source "arch/arm/mach-renesas/Kconfig.rcar4"
source "arch/arm/mach-renesas/Kconfig.rcar5"

endif
```

## board/renesas/perceptor/Kconfig
```kconfig
if TARGET_PERCEPTOR

config SYS_SOC
        default "renesas"

config SYS_BOARD
        default "perceptor"

config SYS_VENDOR
        default "renesas"

config SYS_CONFIG_NAME
        default "perceptor"

endif
```

## configs/r8a779g0_whitehawk_defconfig
```kconfig
#include <configs/renesas_rcar4.config>

CONFIG_ARM=y
CONFIG_ARCH_RENESAS=y
CONFIG_RCAR_GEN4=y
CONFIG_ARM_SMCCC=y
CONFIG_ARMV8_PSCI=y
CONFIG_ENV_SIZE=0x20000
CONFIG_ENV_OFFSET=0xFFFE0000
CONFIG_DEFAULT_DEVICE_TREE="renesas/r8a779g0-white-hawk"
CONFIG_TARGET_WHITEHAWK=y
CONFIG_SYS_CLK_FREQ=16666666
CONFIG_SYS_BOOT_GET_CMDLINE=y
CONFIG_SYS_BARGSIZE=2048
CONFIG_BOOTCOMMAND="setexpr dloadaddr ${loadaddr} + 0x200000 && setexpr dloadaddr ${dloadaddr} \\\\& 0xffc00000 && setexpr kloadaddr ${dloadaddr} + 0x200000 && tftp ${dloadaddr} Image-r8a779g0-white-hawk.dtb && tftp ${kloadaddr} Image && booti ${kloadaddr} - ${dloadaddr}"
CONFIG_DEFAULT_FDT_FILE="r8a779g0-white-hawk.dtb"
CONFIG_CMD_REMOTEPROC=y
CONFIG_REMOTEPROC_RENESAS_APMU=y
CONFIG_SYS_CBSIZE=2048
CONFIG_ENV_IS_IN_MMC=y
CONFIG_ENV_MMC_EMMC_HW_PARTITION=2
CONFIG_BITBANGMII=y
CONFIG_PHY_MICREL=y
CONFIG_PHY_MICREL_KSZ90X1=y
CONFIG_RENESAS_RAVB=y
CONFIG_BAUDRATE=921600
```

## configs/r8a78000_ironhide_defconfig
```kconfig
#include <configs/renesas_rcar5.config>

CONFIG_ARM=y
CONFIG_ARCH_RENESAS=y
CONFIG_NR_DRAM_BANKS=16
CONFIG_RCAR_GEN5=y
CONFIG_ARM_SMCCC=y
CONFIG_ARMV8_PSCI=y
CONFIG_ENV_SIZE=0x20000
CONFIG_ENV_OFFSET=0xFFFE0000
CONFIG_ENV_IS_IN_MMC=y
CONFIG_SYS_MMC_ENV_DEV=0
CONFIG_SYS_MMC_ENV_PART=2
# CONFIG_OF_UPSTREAM is not set
CONFIG_DEFAULT_DEVICE_TREE="r8a78000-ironhide"
CONFIG_TARGET_IRONHIDE=y
CONFIG_SYS_CLK_FREQ=1066666667
CONFIG_SYS_BOOT_GET_CMDLINE=y
CONFIG_SYS_BARGSIZE=2048
CONFIG_BOOTCOMMAND="tftp 0x9E680000 Image && tftp 0x9E600000 r8a78000-ironhide.dtb && booti 0x9E680000 - 0x9E600000"
CONFIG_SYS_CBSIZE=2048
CONFIG_CMD_MEMTEST=y
CONFIG_SYS_ALT_MEMTEST=y
CONFIG_BAUDRATE=1843200
CONFIG_UFS=y
CONFIG_CMD_UFS=y
CONFIG_UFS_RENESAS_GEN5=y
CONFIG_SCSI=y
CONFIG_CMD_SCMI=y
CONFIG_FIRMWARE=y
CONFIG_SCMI_FIRMWARE=y
CONFIG_DM_MAILBOX=y
CONFIG_CLK_SCMI=y
CONFIG_RESET_SCMI=y
CONFIG_POWER_DOMAIN=y
CONFIG_RCAR_MFIS_MBOX=y
CONFIG_SCMI_POWER_DOMAIN=y
CONFIG_SCMI_AGENT_MAILBOX=y
CONFIG_RCAR_SCP_FIXUP=y
```

## configs/rcar-x5h_board_defconfig
```kconfig
#include <configs/renesas_rcar5.config>

CONFIG_ARM=y
CONFIG_ARCH_RENESAS=y
CONFIG_RCAR_GEN5=y
CONFIG_ARM_SMCCC=y
CONFIG_ARMV8_PSCI=y
CONFIG_ENV_SIZE=0x20000
CONFIG_ENV_OFFSET=0xFFFE0000
# CONFIG_OF_UPSTREAM is not set
CONFIG_DEFAULT_DEVICE_TREE="r8a78000-board"
CONFIG_TARGET_RCAR_X5H_BOARD=y
CONFIG_SYS_CLK_FREQ=16666666
CONFIG_SYS_BOOT_GET_CMDLINE=y
CONFIG_SYS_BARGSIZE=2048
CONFIG_BOOTCOMMAND="booti 0x48080000 - 0x48000000"
CONFIG_BOOTARGS="console=ttyAMA0,38400n8 cma=800M root=/dev/vda"
CONFIG_ENV_IS_NOWHERE=y
CONFIG_SYS_CBSIZE=2048
CONFIG_BAUDRATE=1843200
```
