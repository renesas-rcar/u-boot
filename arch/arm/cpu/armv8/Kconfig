## arch/arm/cpu/armv8/Kconfig
```kconfig
if ARM64

config ARMV8_MULTIENTRY
        boolean "Enable multiple CPUs to enter into U-boot"

endif

if RCAR_GEN3

choice
        prompt "Renesas ARM SoCs board select"

config TARGET_SALVATOR_X
        bool "Salvator-X board"

config TARGET_ULCB
        bool "ULCB board"

config TARGET_DRAAK
        bool "Draak board"

endchoice

config R8A7796X
	bool

choice
	prompt "Select Target SoC"

config R8A7795
	bool "Renesas SoC R8A7795"

config R8A77960
	bool "Renesas SoC R8A77960"
	select R8A7796X

config R8A77965
	bool "Renesas SoC R8A77965"
	select R8A7796X

config R8A77995
	bool "Renesas SoC R8A77995"

endchoice

config SYS_SOC
        default "rcar_gen3"

source "board/renesas/salvator-x/Kconfig"
source "board/renesas/ulcb/Kconfig"
source "board/renesas/draak/Kconfig"

endif
```

## arch/arm/mach-rmobile/Kconfig.rcar5
```kconfig
if RCAR_GEN5

menu "Select Target SoC"

config R8A78000
	bool "Renesas SoC R8A78000"
	select GICV3
	imply CLK_R8A78000
	imply PINCTRL_PFC_R8A78000

endmenu

choice
	prompt "Renesas ARM64 SoCs board select"
	optional

config TARGET_RCAR_X5H_BOARD
	bool "R-Car X5H board"
	imply R8A78000
	help
	  Support for Renesas R-Car Gen5 X5H platform

endchoice

source "board/renesas/rcar-x5h-board/Kconfig"

endif
```

## board/renesas/draak/Kconfig
```kconfig
if TARGET_DRAAK

config SYS_SOC
	default "rcar_gen3"

config SYS_BOARD
	default "draak"

config SYS_VENDOR
	default "renesas"

config SYS_CONFIG_NAME
	default "r8a77995_draak" if R8A77995

endif
```

## board/renesas/ebisu/Kconfig
```kconfig
if TARGET_EBISU

config SYS_SOC
	default "rcar_gen3"

config SYS_BOARD
	default "ebisu"

config SYS_VENDOR
	default "renesas"

config SYS_CONFIG_NAME
	default "r8a77990_ebisu" if R8A77990

endif
```

## board/renesas/rcar-x5h-board/Kconfig
```kconfig
if TARGET_RCAR_X5H_BOARD

config SYS_SOC
	default "rmobile"

config SYS_BOARD
	default "rcar-x5h-board"

config SYS_VENDOR
	default "renesas"

config SYS_CONFIG_NAME
	default "rcar-x5h-board"

endif
```

## board/renesas/salvator-x/Kconfig
```kconfig
if TARGET_SALVATOR_X

config SYS_SOC
	default "rcar_gen3"

config SYS_BOARD
	default "salvator-x"

config SYS_VENDOR
	default "renesas"

config SYS_CONFIG_NAME
	default "r8a7795_salvator-x" if R8A7795
	default "r8a7796_salvator-x" if R8A7796

choice
	prompt "Select Target SoC"

config R8A7795
	bool "Renesas SoC R8A7795"

config R8A7796
	bool "Renesas SoC R8A7796"

endchoice
endif
```

## board/renesas/salvatorx/Kconfig
```kconfig
if TARGET_SALVATORX

config SYS_SOC
	default "rcar_gen3"

config SYS_BOARD
	default "salvatorx"

config SYS_VENDOR
	default "renesas"

config SYS_CONFIG_NAME
	default "salvatorx"

endif
```

## board/renesas/ulcb/Kconfig
```kconfig
if TARGET_ULCB

config SYS_SOC
	default "rcar_gen3"

config SYS_BOARD
	default "ulcb"

config SYS_VENDOR
	default "renesas"

config SYS_CONFIG_NAME
	default "h3ulcb" if R8A7795
	default "m3ulcb" if R8A77960

endif
```

## board/renesas/v3msk/Kconfig
```kconfig
if TARGET_V3MSK

config SYS_SOC
	default "rmobile"

config SYS_BOARD
	default "v3msk"

config SYS_VENDOR
	default "renesas"

config SYS_CONFIG_NAME
	default "v3msk"

endif
```

## configs/r8a7795_salvator-x_defconfig
```kconfig
CONFIG_ARM=y
CONFIG_RCAR_GEN3=y
CONFIG_DM_SERIAL=y
CONFIG_TARGET_SALVATOR_X=y
CONFIG_R8A7795=y
CONFIG_SPL=y
CONFIG_SH_SDHI=y
```

## configs/r8a7796_salvator-x_defconfig
```kconfig
CONFIG_ARM=y
CONFIG_RCAR_GEN3=y
CONFIG_DM_SERIAL=y
CONFIG_TARGET_SALVATOR_X=y
CONFIG_R8A77960=y
CONFIG_SPL=y
CONFIG_SH_SDHI=y
```

## configs/r8a77990_ebisu_defconfig
```kconfig
CONFIG_ARM=y
CONFIG_RCAR_GEN3=y
CONFIG_DM_SERIAL=y
CONFIG_TARGET_EBISU=y
CONFIG_R8A77990=y
CONFIG_SPL=y
CONFIG_SH_SDHI=y
```

## configs/r8a77995_draak_defconfig
```kconfig
CONFIG_ARM=y
CONFIG_RCAR_GEN3=y
CONFIG_DM_SERIAL=y
CONFIG_TARGET_DRAAK=y
CONFIG_R8A77995=y
CONFIG_SPL=y
CONFIG_SH_SDHI=y
```

## configs/salvatorx_defconfig
```kconfig
CONFIG_ARM=y
CONFIG_RCAR_GEN3=y
CONFIG_DM_SERIAL=y
CONFIG_TARGET_SALVATORX=y
CONFIG_SPL=y
```

## drivers/mmc/Kconfig
```kconfig
menu "MMC Host controller Support"

config SH_SDHI
	bool "SuperH/Renesas ARM SoCs on-chip SDHI host controller support"
	depends on RMOBILE || RCAR_GEN3
	help
	  Support for the on-chip SDHI host controller on SuperH/Renesas ARM SoCs platform

endmenu
```

## drivers/net/Kconfig
```kconfig
menu "Network Device Support"

config RAVB_1000BASE
	bool "Renesas Ethernet AVB support 1000Base"
	default y if R8A7795 || R8A7796X || R8A77995
	depends on RCAR_GEN3

endmenu
```
