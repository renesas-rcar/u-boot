// SPDX-License-Identifier: GPL-2.0
/*
 * Device Tree Source extras for U-Boot for the Gray Hawk board
 *
 * Copyright (C) 2023 Renesas Electronics Corp.
 */

#include "r8a779h0-gray-hawk.dts"
#include "r8a779h0-u-boot.dtsi"
