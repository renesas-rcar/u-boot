// SPDX-License-Identifier: (GPL-2.0-only OR BSD-2-Clause)
/*
 * Device Tree Source extras for U-Boot for the Perceptor board
 *
 * Copyright (C) 2026 Renesas Electronics Corp.
 */

#include "r8j78070-u-boot.dtsi"
