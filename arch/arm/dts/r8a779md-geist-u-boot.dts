// SPDX-License-Identifier: (GPL-2.0-only OR BSD-2-Clause)
/*
 * Device Tree Source extras for U-Boot for the Geist board with r8a779md
 *
 * Copyright (C) 2025 Renesas Electronics Corp.
 */

#include "r8a779md-geist.dts"
#include "r8a779md-u-boot.dtsi"

&sdhi0 {
	sd-uhs-sdr12;
	sd-uhs-sdr25;
	sd-uhs-sdr104;
	max-frequency = <208000000>;
};

&sdhi2 {
	mmc-ddr-1_8v;
	mmc-hs200-1_8v;
	max-frequency = <200000000>;
};

&vcc_sdhi0 {
	u-boot,off-on-delay-us = <20000>;
};
