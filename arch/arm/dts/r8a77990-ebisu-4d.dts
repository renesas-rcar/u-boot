/* SPDX-License-Identifier: GPL-2.0 */
/*
 * Device Tree Source for the Ebisu-4D board
 *
 * Copyright (C) 2018 Renesas Electronics Corporation
 */

/dts-v1/;
#include "r8a77990-ebisu.dts"

/ {
	model = "Renesas Ebisu-4D board based on r8a77990";
	compatible = "renesas,ebisu", "renesas,r8a77990";

	memory@48000000 {
		device_type = "memory";
		/* first 128MB is reserved for secure area. */
		reg = <0x0 0x48000000 0x0 0x78000000>;
	};
};
