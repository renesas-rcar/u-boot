// SPDX-License-Identifier: GPL-2.0
/*
 * Device Tree Source extras for U-Boot for the Gray Hawk board
 *
 * Copyright (C) 2023-2025 Renesas Electronics Corp.
 */

#include "r8a779h0-u-boot.dtsi"

/ {
	aliases {
		spi0 = &rpc;
	};
};

&rpc {
	status = "disabled";
	flash@0 {
		spi-tx-bus-width = <1>;
		spi-rx-bus-width = <1>;
	};
};
