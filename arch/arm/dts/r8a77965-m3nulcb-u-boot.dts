// SPDX-License-Identifier: GPL-2.0
/*
 * Device Tree Source extras for U-Boot for the ULCB board
 *
 * Copyright (C) 2019 Renesas Electronics Corp.
 * Copyright (C) 2019 Cogent Embedded, Inc.
 */

#include "r8a77965-m3nulcb.dts"
#include "r8a77965-u-boot.dtsi"

&sdhi2_pins {
	groups = "sdhi2_data8", "sdhi2_ctrl", "sdhi2_ds";
	power-source = <1800>;
};

&sdhi2_pins_uhs {
	groups = "sdhi2_data8", "sdhi2_ctrl", "sdhi2_ds";
};

&sdhi0 {
	sd-uhs-sdr12;
	sd-uhs-sdr25;
	sd-uhs-sdr104;
	max-frequency = <208000000>;
};

&sdhi2 {
	mmc-hs400-1_8v;
	max-frequency = <200000000>;
};
