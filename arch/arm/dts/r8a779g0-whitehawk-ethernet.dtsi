// SPDX-License-Identifier: GPL-2.0
/*
 * Device Tree Source for the White Hawk Ethernet sub-board
 *
 * Copyright (C) 2021 Renesas Electronics Corp.
 */

&i2c0 {
	eeprom@53 {
		compatible = "rohm,br24g01", "atmel,24c01";
		label = "ethernet-sub-board-id";
		reg = <0x53>;
		pagesize = <8>;
	};
};
