// SPDX-License-Identifier: GPL-2.0
/*
 * Device Tree Source extras for U-Boot for the Ebisu-4D board
 *
 * Copyright (C) 2018 Marek Vasut <marek.vasut@gmail.com>
 * Copyright (C) 2018 Renesas Electronisc Corporation
 */

#include "r8a77990-ebisu-4d.dts"
#include "r8a77990-u-boot.dtsi"
