// SPDX-License-Identifier: GPL-2.0
/*
 * Device Tree Source extras for U-Boot for the ULCB board
 *
 * Copyright (C) 2018 Renesas Electronics Corporation.
 */

#include "r8a7795-h3ulcb-4x2g.dts"
#include "r8a7795-u-boot.dtsi"
