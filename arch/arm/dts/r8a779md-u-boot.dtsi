// SPDX-License-Identifier: (GPL-2.0-only OR BSD-2-Clause)
/*
 * Device Tree Source extras for U-Boot on R-Car R8A779md SoC
 *
 * Copyright (C) 2025 Renesas Electronics Corp.
 */

#include "r8a779x-u-boot.dtsi"
